AUTOSAR XML (schema 4.0)
package /VehicleSystem
  adaptive application sw component type BrakeController
    provide port BrakeCommand
    require port VehicleSpeed
