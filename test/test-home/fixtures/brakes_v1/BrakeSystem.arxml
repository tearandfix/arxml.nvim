AUTOSAR XML
package /VehicleSystem
  provide port BrakeCommand
  component type BrakeController
    provide port BrakeCommand
    require port VehicleSpeed
