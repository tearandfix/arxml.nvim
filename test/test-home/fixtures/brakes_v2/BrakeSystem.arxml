AUTOSAR XML
package /VehicleSystem
  component type BrakeController
    provide port BrakeCommand
    require port WheelSpeed
